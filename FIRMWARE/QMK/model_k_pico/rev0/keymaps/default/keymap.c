/* Copyright 2024 Brian H (@Trojan_Pinata)
 *
 * This program is free software: you can redistribute it and/or modify
 * it under the terms of the GNU General Public License as published by
 * the Free Software Foundation, either version 2 of the License, or
 * (at your option) any later version.
 *
 * This program is distributed in the hope that it will be useful,
 * but WITHOUT ANY WARRANTY; without even the implied warranty of
 * MERCHANTABILITY or FITNESS FOR A PARTICULAR PURPOSE.  See the
 * GNU General Public License for more details.
 *
 * You should have received a copy of the GNU General Public License
 * along with this program.  If not, see <http://www.gnu.org/licenses/>.
 */

#include QMK_KEYBOARD_H

// screen aliases
#define MTNS 0
#define INFO 1
#define LOGO 2
#define NUM_MODES 3
uint8_t display_mode = INFO;    // defaults to 1 in case of no value

// key that changes OLED
#define OLED_MOD KC_F13

// virtual eeprom for storing last layer
typedef union {
    uint32_t raw;
    struct {
        uint8_t display_mode_saved :NUM_MODES;
    };
} user_config_t;
user_config_t user_config;

// keymaps
const uint16_t PROGMEM keymaps[][MATRIX_ROWS][MATRIX_COLS] = {
    [0] = LAYOUT(
        KC_ESC,           KC_F1,   KC_F2,   KC_F3,   KC_F4,   KC_F5,   KC_F6,   KC_F7,   KC_F8,   KC_F9,   KC_F10,  KC_F11,  KC_F12,  KC_MUTE,

        KC_GRV,  KC_1,    KC_2,    KC_3,    KC_4,    KC_5,    KC_6,    KC_7,    KC_8,    KC_9,    KC_0,    KC_MINS, KC_EQL,  KC_BSPC, KC_DEL,
        KC_TAB,  KC_Q,    KC_W,    KC_E,    KC_R,    KC_T,    KC_Y,    KC_U,    KC_I,    KC_O,    KC_P,    KC_LBRC, KC_RBRC, KC_BSLS, KC_INS,
        KC_CAPS, KC_A,    KC_S,    KC_D,    KC_F,    KC_G,    KC_H,    KC_J,    KC_K,    KC_L,    KC_SCLN, KC_QUOT,          KC_ENT,  KC_HOME,
        KC_LSFT, KC_Z,    KC_X,    KC_C,    KC_V,    KC_B,    KC_N,    KC_M,    KC_COMM, KC_DOT,  KC_SLSH,          KC_RSFT, KC_UP,   KC_END,
        KC_LCTL, KC_LWIN, KC_LALT,                            KC_SPC,                    KC_RALT, MO(1),   KC_RCTL, KC_LEFT, KC_DOWN, KC_RGHT
    ),
    [1] = LAYOUT(
        QK_BOOT,          KC_F13,   KC_F14, KC_F15,  KC_F16,  KC_F17,  KC_F18,  KC_F19,  KC_F20,  KC_F21,  KC_F22,  KC_F23,  KC_F24,  KC_MUTE,

        EE_CLR,  KC_TRNS, KC_TRNS, KC_TRNS, KC_TRNS, KC_TRNS, KC_TRNS, KC_TRNS, KC_TRNS, KC_TRNS, KC_TRNS, KC_TRNS, KC_TRNS, KC_TRNS, KC_VOLU,
        DB_TOGG, KC_TRNS, KC_TRNS, KC_MYCM, KC_TRNS, KC_TRNS, KC_TRNS, KC_TRNS, KC_TRNS, KC_TRNS, KC_TRNS, KC_TRNS, KC_TRNS, KC_TRNS, KC_VOLD,
        KC_TRNS, KC_TRNS, KC_TRNS, KC_TRNS, KC_TRNS, KC_TRNS, KC_TRNS, KC_TRNS, KC_TRNS, KC_TRNS, KC_TRNS, KC_TRNS,          KC_EXEC, KC_MPLY,
        KC_TRNS, KC_TRNS, KC_TRNS, KC_TRNS, KC_CALC, KC_TRNS, KC_TRNS, KC_TRNS, KC_TRNS, KC_TRNS, KC_TRNS,          KC_TRNS, KC_TRNS, KC_TRNS,
        KC_TRNS, KC_TRNS, KC_TRNS,                            KC_TRNS,                   KC_TRNS, KC_TRNS, KC_TRNS, KC_MPRV, KC_TRNS, KC_MNXT
    )
};

// encoder handling
#if defined(ENCODER_MAP_ENABLE)
const uint16_t PROGMEM encoder_map[][NUM_ENCODERS][NUM_DIRECTIONS] = {
    [0] = { ENCODER_CCW_CW(KC_VOLD, KC_VOLU) },
    [1] = { ENCODER_CCW_CW(KC_VOLD, KC_VOLU) },
};
#endif

// oled stuff below
#ifdef OLED_ENABLE

// hold only let me just drop all of my embedded images rq
static const char PROGMEM bootscreen[] = {
    // 'base', 128x32px
    0x00, 0x00, 0x00, 0x00, 0x00, 0x00, 0x00, 0x00, 0x00, 0x00, 0x00, 0x00, 0x00, 0x00, 0x00, 0x00,
    0x00, 0x00, 0x00, 0x00, 0xc0, 0xc0, 0xc0, 0x80, 0x00, 0x00, 0x00, 0x00, 0x00, 0x80, 0xc0, 0xc0,
    0xc0, 0x00, 0x00, 0x00, 0x00, 0x00, 0x00, 0x00, 0x00, 0x00, 0x00, 0x00, 0x00, 0x00, 0x00, 0x00,
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    0x00, 0x00, 0x00, 0x00, 0x00, 0x00, 0x00, 0x00, 0x00, 0x00, 0x00, 0x00, 0x00, 0x00, 0x00, 0x00
};


static const char PROGMEM invertlogo[] = {
    // 'inv', 128x32px
    0xff, 0xff, 0xff, 0xff, 0xff, 0xff, 0xff, 0xff, 0xff, 0xff, 0xff, 0xff, 0xff, 0xff, 0xff, 0xff,
    0xff, 0xff, 0xff, 0xff, 0x3f, 0x3f, 0x3f, 0x7f, 0xff, 0xff, 0xff, 0xff, 0xff, 0x7f, 0x3f, 0x3f,
    0x3f, 0xff, 0xff, 0xff, 0xff, 0xff, 0xff, 0xff, 0xff, 0xff, 0xff, 0xff, 0xff, 0xff, 0xff, 0xff,
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    0xff, 0xff, 0xff, 0xff, 0xff, 0xff, 0xff, 0xff, 0xff, 0xff, 0xff, 0xff, 0xff, 0xff, 0xff, 0xff
};

static const char PROGMEM layer0[] = {
    // 'base', 128x32px
    0x00, 0x00, 0x00, 0x80, 0x40, 0x40, 0x40, 0xa0, 0xb0, 0xf0, 0xd0, 0xd0, 0xf8, 0xfc, 0xdc, 0xfe,
    0xff, 0xff, 0xff, 0xdf, 0xde, 0xde, 0x9c, 0xfc, 0xfc, 0xf8, 0xf8, 0xf0, 0xf0, 0x90, 0xa0, 0x40,
    0x40, 0x40, 0x80, 0x80, 0x80, 0x00, 0x00, 0x00, 0x00, 0x00, 0x00, 0x00, 0x00, 0x80, 0x80, 0x80,
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    0x00, 0x00, 0x01, 0x01, 0x03, 0x02, 0x06, 0x06, 0x0c, 0x08, 0x08, 0x10, 0x30, 0x20, 0x20, 0x60
};

static const char PROGMEM layer1[] = {
    // 'alt', 128x32px
    0x00, 0x00, 0x00, 0x80, 0x40, 0x40, 0x40, 0xa0, 0xb0, 0xf0, 0xd0, 0xd0, 0xf8, 0xfc, 0xdc, 0xfe,
    0xff, 0xff, 0xff, 0xdf, 0xde, 0xde, 0x9c, 0xfc, 0xfc, 0xf8, 0xf8, 0xf0, 0xf0, 0x90, 0xa0, 0x40,
    0x40, 0x40, 0x80, 0x80, 0x80, 0x00, 0x00, 0x00, 0x00, 0x00, 0x00, 0x00, 0x00, 0x80, 0x80, 0x80,
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    0x00, 0x00, 0x01, 0x01, 0x03, 0x02, 0x06, 0x06, 0x0c, 0x08, 0x08, 0x10, 0x30, 0x20, 0x20, 0x60
};

// MTNS
static void mountains(void) {
    switch (get_highest_layer(layer_state)) {
        case 0:
            oled_write_raw_P(layer0, sizeof(layer0));
            break;
        case 1:
            oled_write_raw_P(layer1, sizeof(layer1));
            break;
        default:
            oled_write_raw_P(layer0, sizeof(layer0));
            break;
    }
}

// INFO
static void info(void) {
    // get layer the board is on
    oled_write_P(PSTR("LAYER "), false);
    oled_write_P(PSTR(" "), true);
    oled_write_char(get_highest_layer(layer_state) + 0x30, true);
    oled_write_P(PSTR(" "), true);

    // here we do a bit of trickery
    oled_write_P(PSTR(" ENC "), false);
    oled_write_P(PSTR(" VOL "), true);

    // lock key statuses
    led_t led_state = host_keyboard_led_state();
    oled_set_cursor(9, 1);
    oled_write_P(PSTR(" CAP "), led_state.caps_lock);
    oled_set_cursor(14, 1);
    oled_write_P(PSTR(" SCR "), led_state.scroll_lock);

    // write model B here in invert text
    oled_set_cursor(0, 3);
    oled_write_P(PSTR(" MODEL-K "), true);

    // mod masks - if you don't know what these do, don't worry about them
    uint8_t mod_state = get_mods();
    oled_advance_char();
    oled_advance_char();
    oled_write_P(PSTR("S"), mod_state & MOD_MASK_SHIFT);
    oled_advance_char();
    oled_write_P(PSTR("C"), mod_state & MOD_MASK_CTRL);
    oled_advance_char();
    oled_write_P(PSTR("A"), mod_state & MOD_MASK_ALT);
    oled_advance_char();
    oled_write_P(PSTR("G"), mod_state & MOD_MASK_GUI);
    oled_advance_char();
}

// display logo - used on boot and exception state
static void logo(void) {
    oled_write_raw_P(bootscreen, sizeof(bootscreen));
}

// logo, but also have some signifier for the current layer
static void logo_with_layer(void) {
    switch (get_highest_layer(layer_state)) {
        case 0:
            oled_write_raw_P(bootscreen, sizeof(bootscreen));
            break;
        case 1:
            oled_write_raw_P(invertlogo, sizeof(invertlogo));
            break;
        default:
            oled_write_raw_P(bootscreen, sizeof(bootscreen));
            break;
    }
}

// run this whenever the oled needs to update
bool oled_task_user(void) {
    user_config.raw = eeconfig_read_user(); // read saved config
    display_mode = user_config.display_mode_saved;
    switch (display_mode) {
        case MTNS:
            mountains();
            break;
        case INFO:
            info();
            break;
        case LOGO:
            logo_with_layer();
            break;
        default:
            logo();
    }
    return false;
}

// what happens on sleep/power down
void suspend_power_down_user(void) {
    oled_off();
}

// render this on boot/reset
void oled_render_boot(bool bootloader) {
    oled_clear();
    logo();
    oled_render_dirty(true);
}

// run this on boot/reset
bool shutdown_user(bool jump_to_bootloader) {
    oled_render_boot(jump_to_bootloader);
    return false;
}

// change depending on if OLED_MOD is pressed
bool process_record_user(uint16_t keycode, keyrecord_t *record) {
    if (keycode == OLED_MOD) {
        if (record->event.pressed) {
            oled_clear();
            if (display_mode == NUM_MODES - 1) {
                display_mode = 0;
            }
            else {
                display_mode++;
            }
            user_config.display_mode_saved = display_mode;
            eeconfig_update_user(user_config.raw);  // update config when screen changes
        }
    }
    return true;
}

#endif
